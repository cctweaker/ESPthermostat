//////////////////////////////////////////////////////////////////////////////////////////
//////////////////////////////////////////////////////////////////////////////////////////
//////////////////////////////////////////////////////////////////////////////////////////

void init_thermostat()
{
    if (!cfg_thermostat)
        return;

    if (use_expander)
    {
        max_channels = 4;
    }
    else
    {
        max_channels = 2;
    }

    init_1wire();

    use_thermostat = true;
}

//////////////////////////////////////////////////////////////////////////////////////////
//////////////////////////////////////////////////////////////////////////////////////////
//////////////////////////////////////////////////////////////////////////////////////////

void init_1wire()
{
    sensors.begin();
    onewire_device_count = sensors.getDeviceCount();
    sensors.requestTemperatures();
    last_temp_read = millis();
    use_1wire = true;
}

//////////////////////////////////////////////////////////////////////////////////////////
//////////////////////////////////////////////////////////////////////////////////////////
//////////////////////////////////////////////////////////////////////////////////////////

void thermostat_loop()
{
    if (use_1wire)
        if ((unsigned long)(millis() - last_temp_read) > 1000)
        {
            for (int i = 0; i < onewire_device_count; i++)
                onewire_temp[i] = sensors.getTempCByIndex(i);

            sensors.requestTemperatures();
        }
}

//////////////////////////////////////////////////////////////////////////////////////////
//////////////////////////////////////////////////////////////////////////////////////////
//////////////////////////////////////////////////////////////////////////////////////////

void update_channel(uint8_t channel, bool value)
{
    if (use_expander)
    {
    }
    else
    {
        if (value)
        {
            pinMode(channel_to_pin[channel - 1], OUTPUT);
            digitalWrite(channel_to_pin[channel - 1], LOW);
            channel_timeout[channel - 1] = millis();
            channel_timeout_check[channel - 1] = true;
        }
        else
        {
            pinMode(channel_to_pin[channel - 1], INPUT_PULLUP);
            channel_timeout_check[channel - 1] = false;
        }
    }
}

//////////////////////////////////////////////////////////////////////////////////////////
//////////////////////////////////////////////////////////////////////////////////////////
//////////////////////////////////////////////////////////////////////////////////////////